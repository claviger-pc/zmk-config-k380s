## Kconfig.board
```kconfig
# CKP boards configuration

# Copyright (c) 2022 The ZMK Contributors
# SPDX-License-Identifier: MIT

config BOARD_K380S
    bool "k380s"
    depends on SOC_NRF52832_QFAB
```

## Kconfig.defconfig
```kconfig
# Copyright (c) 2022 The ZMK Contributors
# SPDX-License-Identifier: MIT

config BOARD
    default "k380s" if BOARD_K380S
config ZMK_KEYBOARD_NAME
    default "k380s" if BOARD_K380S

if BOARD_K380S

config USB_NRFX
    default n

config USB_DEVICE_STACK
    default n


config BT_CTLR
    default BT

endif 
```
